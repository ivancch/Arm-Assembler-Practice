; Подключить библиотеку макроопределений 
			GET MyMacro1.s
; Объявить кодовую секцию MyCode
			AREA MyCode8, CODE, ReadOnly
; Объявить точку входа в программу приложения	
			ENTRY
; Объвить точку входа глобальной переменной
			EXPORT AddAndSubDWord
AddAndSubDWord

	; Сложение и вычитание двух слов
;			B Variation_1

	; Сложение и вычитание двух слов
	; используя макрокоманды
;			B Variation_2
	
	; Загрузка из ОЗУ двойных слов и выгрузка
	; туда же результата их сложение и вычитания
	; при помощи макрокоманд
			B Variation_3
	
; Выход из подпрограммы
Back
			BX lr

Variation_1
; Вычисление суммы и разности двух двойных слов
; Инициализация первого двойного слова
			LDR r2, =0xff225555
			LDR r1, =0x4444aaaa
; Инициализация второго двойного слова
			LDR r4, =0x22113333
			LDR r3, =0xBBBB2222
; Расчет суммы двойных слов
SUM_D
; Сумма младших слов
			ADDS r5, r1, r3
; Сумма старших слов
			ADCS r6, r2, r4
; Учет возможного переполнения 
			MOV r7, #0
			ADC r7, #0			
; Расчет разности двойных слов
SUB_D
; Разность младших слов
			SUBS r5, r1, r3
; Разность старших слов
			SBCS r6, r2, r4			
; Учет возможного "заема" 
			MOV r7, #0
			SBC r7, #0
; Выход из подпрограммы
			B Back
			
			

Variation_2
; Вычисление суммы и разности двух двойных слов
; Инициализация первого двойного слова
			LDR r2,=0xFF225555
			LDR r1,=0x4444AAAA
; Инициализация второго двойного слова
			LDR r4,=0x22113333
			LDR r3,=0xBBBB2222
; Расчет суммы двойных слов
SUM_D_v2
; Макровызов операции сложения двойных слов 
			D_ADD r2, r1, r4, r3, r7, r6, r5
; Расчет разности двойных слов
			D_SUB r2, r1, r4, r3, r7, r6, r5
; Макровызов операции вычитания двойных слов
; Выход из подпрограммы
			B Back	

Variation_3

; Начальный адрес массива двойных слов в памяти
			LDR r0, =RAM_0 
; Загрузить пару двойных слов в регистры ЦПУ из памяти
; E int 0x200000A0=0xFF225555,0x4444AAAA,0x22113333,0xBBBB2222
			D_LOAD r1, r2, r3, r4, r0
; Расчет суммы двойных слов
			D_ADD r2, r1, r4, r3, r7, r6, r5
; Начальный адрес массива для результата слов в памяти
			LDR r0, =Result
; Сохранение трех слов результата сложения в памяти
			SAVE_3W r7, r6, r5, r0
			D_SUB r2, r1, r4, r3, r7, r6, r5
; Сохранение трех слов результата вычитания в памяти
			SAVE_3W r7, r6, r5, r0
; завершение подпрограммы
			B Back
			
			ALIGN

			AREA MyData8, DATA, ReadWrite
RAM_0   	SPACE 4*4
Result		SPACE 3*4
	
			
; Конец ассемблерного текста
			END
				